## boards/shields/cool640lp/Kconfig.defconfig
```kconfig
if SHIELD_COOL640LP

# Name must be less than 16 characters long!
config ZMK_KEYBOARD_NAME
    default "cool640lp"

endif
```

## boards/shields/cool640lp/Kconfig.shield
```kconfig
# No whitespace after the comma or in your keyboard name!
config SHIELD_COOL640LP
    def_bool $(shields_list_contains,cool640lp)
```
