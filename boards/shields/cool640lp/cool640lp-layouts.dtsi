/ {
    physical_layout0: physical_layout_0 {
        compatible = "zmk,physical-layout";
        display-name = "Default Layout";
    };
};
&physical_layout0 {
    kscan = <&kscan0>;
    transform = <&matrix_transform0>;
};
